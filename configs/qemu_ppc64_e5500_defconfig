## configs/qemu_ppc64_e5500_defconfig
```kconfig
# Architecture
BR2_powerpc64=y
BR2_powerpc_e5500=y

# Serial port config
BR2_TARGET_GENERIC_GETTY_PORT="ttyS0"

# Image
BR2_ROOTFS_POST_IMAGE_SCRIPT="board/qemu/post-image.sh"
BR2_ROOTFS_POST_SCRIPT_ARGS="$(BR2_DEFCONFIG)"

# Linux headers same as the kernel
BR2_PACKAGE_HOST_LINUX_HEADERS_CUSTOM_5_4=y

# Kernel
BR2_LINUX_KERNEL=y
BR2_LINUX_KERNEL_CUSTOM_VERSION=y
BR2_LINUX_KERNEL_CUSTOM_VERSION_VALUE="5.4.58"
BR2_LINUX_KERNEL_DEFCONFIG="corenet64_smp"
BR2_LINUX_KERNEL_CONFIG_FRAGMENT_FILES="board/qemu/ppc64-e5500/linux.fragment"
BR2_LINUX_KERNEL_NEEDS_HOST_OPENSSL=y

# Filesystem
BR2_TARGET_ROOTFS_EXT2=y
# BR2_TARGET_ROOTFS_TAR is not set

# host-qemu for gitlab testing
BR2_PACKAGE_HOST_QEMU=y
BR2_PACKAGE_HOST_QEMU_SYSTEM_MODE=y

BR2_LINUX_KERNEL_INSTALL_TARGET=y
BR2_PACKAGE_CA_CERTIFICATES=y
BR2_PACKAGE_HOST_MENDER_ARTIFACT=y
BR2_PACKAGE_MENDER=y
BR2_PACKAGE_NTP=y
BR2_PACKAGE_NTP_SNTP=y
BR2_PACKAGE_HOST_GENEXT2FS=y
BR2_PACKAGE_XZ=y
BR2_PACKAGE_UBOOT_TOOLS=y

BR2_TARGET_ROOTFS_EXT2_SIZE="512M"

BR2_GCC_VERSION_10_X=y
BR2_GCC_VERSION="10.2.0"

BR2_TOOLCHAIN_BUILDROOT_GO=y
```

## configs/qemu_x86_64_defconfig
```kconfig
# Architecture
BR2_x86_64=y

# Toolchain
BR2_TOOLCHAIN_BUILDROOT_GLIBC=y
BR2_TOOLCHAIN_BUILDROOT_CXX=y

# System
BR2_SYSTEM_DHCP="eth0"
# Serial port config
BR2_TARGET_GENERIC_GETTY_PORT="ttyS0"

# Filesystem
BR2_TARGET_ROOTFS_EXT2=y
# BR2_TARGET_ROOTFS_TAR is not set

# Linux headers same as kernel, a 4.19 series
BR2_PACKAGE_HOST_LINUX_HEADERS_CUSTOM_4_19=y

# Kernel
BR2_LINUX_KERNEL=y
BR2_LINUX_KERNEL_CUSTOM_VERSION=y
BR2_LINUX_KERNEL_CUSTOM_VERSION_VALUE="4.19.16"
BR2_LINUX_KERNEL_USE_CUSTOM_CONFIG=y
BR2_LINUX_KERNEL_CUSTOM_CONFIG_FILE="board/qemu/x86_64/linux.config"

BR2_PACKAGE_PYTHON3=y
BR2_PACKAGE_PYTHON_MENDER=y
```

## package/mender-artifact/Config.in.host
```kconfig
config BR2_PACKAGE_HOST_MENDER_ARTIFACT
    depends on BR2_PACKAGE_HOST_GO_ARCH_SUPPORTS
    depends on BR2_PACKAGE_HOST_GO_CGO_LINKING_SUPPORTS
    depends on BR2_TOOLCHAIN_HAS_THREADS
    bool "host mender-artifact"
    help
      Mender image artifact tool
```

## package/mender/Config.in
```kconfig
config BR2_PACKAGE_MENDER
	bool "mender"
	depends on BR2_PACKAGE_HOST_GO_TARGET_ARCH_SUPPORTS
	depends on BR2_PACKAGE_HOST_GO_TARGET_CGO_LINKING_SUPPORTS
	depends on BR2_TOOLCHAIN_HAS_THREADS
	select BR2_PACKAGE_XZ
	select BR2_PACKAGE_UBOOT_TOOLS if BR2_TARGET_UBOOT # runtime
	select BR2_PACKAGE_UBOOT_TOOLS_FWPRINTENV if BR2_TARGET_UBOOT # runtime
	help
	  Mender is an open source over-the-air (OTA) software updater
	  for embedded Linux devices. Mender comprises a client
	  running at the embedded device, as well as a server that
	  manages deployments across many devices.

	  https://github.com/mendersoftware/mender

if BR2_PACKAGE_MENDER

config BR2_PACKAGE_MENDER_UPDATE_MODULES
	bool "Install reference Update Modules"
	select BR2_PACKAGE_BASH
	help
	  Update Modules are small extensions to the Mender client
	  which allows definition of custom install/update types.

	  Enabling this option will install a selection of reference
	  modules that are part of the Mender client source tree.
endif

comment "mender needs a toolchain w/ threads"
	depends on BR2_PACKAGE_HOST_GO_TARGET_ARCH_SUPPORTS
	depends on BR2_PACKAGE_HOST_GO_TARGET_CGO_LINKING_SUPPORTS
	depends on !BR2_TOOLCHAIN_HAS_THREADS
```

## package/python-mender/Config.in
```kconfig
config BR2_PACKAGE_PYTHON_MENDER
	bool "python-mender"
	depends on BR2_USE_MMU # python
	depends on BR2_USE_WCHAR # python
	depends on BR2_TOOLCHAIN_HAS_THREADS # python
	depends on !BR2_STATIC_LIBS # python
	select BR2_PACKAGE_PYTHON_CRYPTOGRAPHY # runtime
	select BR2_PACKAGE_PYTHON_REQUESTS # runtime
	select BR2_PACKAGE_PYTHON_SETUPTOOLS # runtime
	help
	  Mender is an open source over-the-air (OTA) software updater
	  for embedded Linux devices. Mender comprises a client
	  running at the embedded device, as well as a server that
	  manages deployments across many devices.

	  https://github.com/mendersoftware/mender-python-client
```
